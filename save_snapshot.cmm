;/************************************************************
;* Percepio Tracealyzer - ITM Trace Exporter for Lauterbach TRACE32
;* Copyright (c) 2021, Percepio AB.
;* https://percepio.com
;************************************************************/

LOCAL  &file
ENTRY &file


if "&file"==""
  &file="tracealyzer.bin"

if run()
  break

data.save.Binary &file y.range(RecorderData)

enddo

