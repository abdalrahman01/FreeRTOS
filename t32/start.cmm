; Basic setup
  RESet
  SYStem.RESet
  SYStem.CPU STM32F407IG
  SYStem.CONFIG.DEBUGPORTTYPE SWD
  SYStem.MemAccess DAP
  SYStem.Option DUALPORT ON
  SYStem.Up


  ; Setup flash configuration using the board support scripts of the TRACE32 installation
  DO ~~/demo/arm/flash/stm32f4xx.cmm PREPAREONLY DUALPORT=1

  ; Program the internal flash
  FLASH.ReProgram.ALL /Erase
  Data.LOAD.Elf ~~~~/../out/rtx/Target1/rtx.axf
  FLASH.ReProgram.off

  ; Reset device
  SYStem.Down
  SYStem.Up

  go main\29
  wait !STATE.RUN()

  ; load FreeRTOS kernel awareness
  TASK.CONFIG ~~/demo/arm/kernel/freertos/freertos.t32
  MENU.ReProgram ~~/demo/arm/kernel/freertos/freertos.men



  ; Prevent error during power saving states and stop peripherals in debug mode
  Data.Set E:0xE0042004 %Long 0yXXXXxxxxXXX11111XXXXxxxxXXXXx111  ; DBGMCU_CR
  ; Setup GPIO clock
  Data.Set E:0x40023830 %Long 0yXXXXxxxxXXXXxxxxXXXXxxxxXXX1xxxx  ; RCC_AHB1ENR
  ; Setup pin multiplexing for using the 4 bit trace
  Data.Set E:0x40021000 %Long 0yXXXXxxxxXXXXxxxxXX1010101010xxxx  ; GPOIE_PORTMODE
  Data.Set E:0x40021008 %Long 0yXXXXxxxxXXXXxxxxXX1111111111xxxx  ; GPOIE_PORTSPEED
  Data.Set E:0x40021020 %Long 0yXXXX00000000000000000000XXXXxxxx  ; GPIOE_AFRL

if CAnalyzer()||Analyzer()
(
  TPIU.PortMode Continuous
  TPIU.PortSize 4.
  ETM.ON

  itm.DATATRACE CORRELATEDDATA
  itm.on
  trace.mode FIFO
)
IF Analyzer()
(
    Analyzer.TERMination ON
    Analyzer.THreshold  1.65
    Analyzer.SAMPLE TP0 +0.000
    Analyzer.SAMPLE TP1 +0.000
    Analyzer.SAMPLE TP2 +0.468
    Analyzer.SAMPLE TP3 +0.000
    t.tf
)
if CAnalyzer()
  t.af



  ENDDO