;/************************************************************
;* Percepio Tracealyzer - ITM Trace Exporter for Lauterbach TRACE32
;* Copyright (c) 2021, Percepio AB.
;* https://percepio.com
;************************************************************/


if SYStem.MEMACCESS()!="DENIED"
(
  data.set E:tz_host_command_data  %byte 1 0 0 0 0 0 0xfe 0xff
  data.set E:tz_host_command_bytes_to_read %long 8
)
else
  dialog.ok "Memaccess must be enabled to use this feature"

enddo